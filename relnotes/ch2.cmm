.ds FF Flex\s-1FAX\s+1
.nr H1 1
.H 1 "Installation Information"
.\"
.\"	Developer
.\"
This chapter lists supplemental information to 
the \f2IRIS Software Installation Guide.\f1
The information listed here is product-specific;
use it with the Installation Guide to install 
this product.
.H 2 "\*(FF Subsystems"
..\"
.\" Each subsystem should be described in enough detail so that
.\" users can decide whether or not they need to install it.
.\" Hints such as "You need to install this subsystem if you want to use
.\" Visual System Administration Tools" or "This subsystem is useful only
.\" if you want to display Kanji characters" would be nice. For subsystems
.\" such as eoe2.sw.4Dwm that are important if you have graphics, but not 
.\" important for servers and aren't marked required in the spec file (inst 
.\" doesn't show + and doesn't require their installation), be sure to make
.\" this very clear in the description or in a separate list.
.\"
The \*(FF software includes these subsystems:
.VL 30
.LI "\f2flexfax.sw.client\f1"
Software for sending facsimile and
querying the status of \*(FF servers.
.LI "\f2flexfax.man.client\f1"
Manual pages for client programs.
.LI "\f2flexfax.sw.server\f1"
Software for running a \*(FF server.
.LI "\f2flexfax.man.readme\f1"
Basic information about the system, including setup and maintenance.
.LI "\f2flexfax.man.server\f1"
Manual pages for the server software.
.LI "\f2flexfax.man.relnotes\f1"
Release notes (this document)
.LI "\f2flexfax.man.doc\f1"
Miscellaneous supporting documentation, including
information about the Class 1 and Class 2 host-modem
programming interfaces.
.LE
.H 2 "\*(FF Subsystem Disk Space Requirements"
.\"
.\" The size of each subsystem should be listed so that users get an idea
.\" of the disk space requirements before they get into inst.
.\"
This section lists the subsystems (and their sizes) of the \*(FF option.
.P
Those marked ``default'' are the default subsystems.
If you are installing this option for the first time,
these are the subsystems that are installed if you
use the ``go'' menu item.
To install a different set of subsystems, use 
the ``install,'' ``remove,'' ``keep,'' and ``step'' commands 
in \f2inst\f1 to customize the list of subsystems to be
installed, then select the ``go'' menu item.
.VL 7
.LI "\f6Note:\f1"
The listed subsystem sizes are approximate. 
Refer to the 
\f2IRIS Software Installation Guide\f1
for information on finding exact sizes.
.LE
.ps 9
.vs 11
.TS
tab(:);
lw(2.75i):lw(1.5i)
lw(2.75i):lw(1.5i)
lIw(2.75i):nw(1.5i).
\f6Subsystem Name:Subsystem Size
:\f6(kilobytes)\f1
.ps 10
.vs 12
.sp 0.3
flexfax.sw.client:\f11786
.br
\f1(default)\fP
.sp 0.3
flexfax.sw.server:\f12464
.sp 0.3
flexfax.man.client:\f138
.br
\f1(default)\fP
.sp 0.3
flexfax.man.server:\f181
.sp 0.3
flexfax.man.readme:\f146
.br
\f1(default)\fP
.sp 0.3
flexfax.man.relnotes:\f121
.br
\f1(default)\fP
.sp 0.3
flexfax.man.doc:\f181
.TE
.ps 11
.vs 13
.H 2 "Installation Method"
All of the subsystems for \*(FF can be installed using IRIX.
You do not need to use the miniroot. Refer to the \f2IRIS Software 
Installation Guide\f1 for complete installation instructions.
.ps 10
.vs 12
.H 2 "Prerequisites"
.\"
.\" Delete this section if it does not apply.
.\"
.\" Every prerequisite of every subsystem should be listed whether it's in
.\" spec file or not. Be sure to include specific release numbers when
.\" the prerequisite is a subsystem in a different product.  If there are
.\" many prerequisites, you might want to list them in a table. 
.\"
.\" Examples of prerequisite information are:
.\"
If you want to install flexfax.sw.server, you must also install
dps_eoe.sw.dps and dps_eoe.sw.dpsfonts.
.\" If you want to install a.b.c, release n.0 or later of x.y.z must be
.\" installed.
Your workstation must be running at least release 4D1-4.0.1 in order to
use version 2.2.2 of this software.
Note that there are two different binary installation packages;
one for IRIX 4.X systems and another for IRIX 5.X systems.
If you try to run the IRIX 4.X system under IRIX 5.X the fax server
will terminate prematurely.
IRIX 4.X client applications work under IRIX 5.X without any problems;
however it is advisable to use the IRIX 5.X binaries since they will
take advantage of the IRIX 5.X DSO support.
.\"
.H 2 "Configuration Files"
.\"
.\" Delete this section if it does not apply.
.\"
.\" List the configuration files in your product.  Tell what their purpose
.\" is and give users some idea of how and why they might want to modify them.
.\" You should also discuss each of the changes made in each of the 
.\" configuration files for this release to make the process of merging
.\" local changes with SGI changes easier for users.
.\"
.fp 4 HD
This section lists installed files that can be edited to contain
site-specific changes.
Please see the server manual pages for complete details.
.P
The following configuration files determine if one or more
facsimile server processes are started during system initialization.
The facsimile system is enabled if the configuration flag
in the \f2/etc/config\fP directory is in the ``on'' state.
Use the \f2chkconfig\fP(1M) command to turn a flag on or off.
.VL 10
.LI "\f2/etc/config/fax\fP"
Start a \f2faxd\fP(1M) process for each configured modem.
.LE
.P
Change the following files to reflect your site's setup:
.VL 10
.LI "\f2/usr/spool/fax/etc/config.\fPfoo"
The configuration file for the /dev/\f2foo\fP modem device.
This file contains information such as the phone number associated
with the modem, and whether or not the server should permit
incoming data connections.
Consult \f2faxaddmodem\fP(1M) and
\f2config\fP(4F) for complete information.
.LI "\f2/usr/spool/fax/\s-1FIFO\s+1.\fPfoo"
This is a \s-1FIFO\s+1 special file that must exist for each modem device
attached to a host.
The file is normally create with mode 600 and owned by user ``uucp''.
The system startup script will create a fax server process for
each device that has both a configuration file and a \s-1FIFO\s+1
special device file.
The installation procedure for a server uses the
\f2faxaddmodem\fP(1M) script to setup this file and
the configuration file.
.LE
.P
The following files may be modified to suit site-specific needs:
.VL 10
.LI "\f2/usr/local/lib/fax/typerules\fP"
A set of rules that specify how to convert a file submitted for
transmission to a format supported by the facsimile server (PostScript
or \s-1TIFF/F\s+1).
Consult \f2typerules\fP(4F) for a description of this file.
.LI "\f2/usr/local/lib/fax/faxcover.ps\fP"
A stylized PostScript document that is used
when creating cover pages for outgoing facsimile.
See the \f2faxcover\fP(1) program for details on the format.
.LI "\f2/usr/spool/fax/bin/notify\fP"
The shell script that is used by the server to notify users
of job status changes.
The default script sends electronic mail to the user that submitted the job.
.LI "\f2/usr/spool/fax/bin/faxrcvd\fP"
The shell script that is invoked by the server when a facsimile
is received.
The default script sends electronic mail to the ``FaxMaster'' user.
.LI "\f2/usr/spool/fax/bin/pollrcvd\fP"
The shell script that is invoked by the server when a facsimile
is received due to a poll operation.
The default script delivers the facsimile by electronic mail.
.LI "\f2/usr/spool/fax/bin/ps2fax\fP"
The shell script that is used by the server to convert a PostScript document
to a \s-1TIFF\s+1 document for transmission.
The default script invokes a Display PostScript-based imaging program.
This file is usually a link to either \f2/usr/spool/fax/bin/ps2fax.dps\fP
or \f2/usr/spool/fax/bin/ps2fax.gs\fP.
.LE
.H 2 "Other Installation Information"
[\fBIf you are unfamiliar with the terminology used in the following
description, refer to the document
\f2/usr/local/doc/flexfax/modems-faq\fP.\f1]
.P
Note that you need a fax modem to use this software.
Fax modems are not the same as data modems,
though many of contemporary fax modems also
function well as data modems.
The modems listed in the introduction 
are known to work with this release (though some perform
better than others).
This software tries to support any facsimile modem
that provides either the
Telecommunications Industry Associate (TIA)
Standards Proposal No. 2388-A of August 30, 1991\(emso called
``\f2Class 2-style\fP modems''\(emor the
Telecommunications Industry Associate (TIA)
Standard 578 of October 22, 1990\(emso called
``\f2Class 1-style\fP modems''.
.P
With the executables installed and the appropriate system configuration
information setup, the modem must be prepared for use:
.P
First.  Make sure that your modem works.  One can not say this enough.
If you can not use cu, tip, uucp, or some similar program
to communicate with your modem, do not
try to configure the modem for use with \*(FF.  This means in
particular that you should verify that you have a working cable between
your host and modem and that this cable is suitable for use.  That is,
that the cable has the relevant signals for doing hardware flow control
if that is necessary and that it passes the \s-1DCD\s+1 and \s-1DTR\s+1 signals
appropriately.  On Silicon Graphics
Indigo systems you \fBcan not use a Macintosh cable
to connect your modem\fP.  Once again, repeat after me, ``\fByou can not use a
Macintosh cable to connect your modem to a Silicon Graphics Indigo\fP.''
It may look like it works, but the moment that you try to use hardware flow control
(i.e. \s-1RTS/CTS\s+1) the data will be garbled and you will encounter
problems.  Consult the \f2serial\fP(7) manual page for an
explanation of how to wire up modem cables.  Note also that
the tty port name selected for a modem must reflect whether
hardware or software (\s-1XON/XOFF\s+1) flow control is to be used\(emttyf*
devices use \s-1RTS/CTS\s+1 flow control and ttym* devices use \s-1XON/XOFF\s+1 flow
control.  The rules to use for selecting a flow control method are:
.BL
.LI
If you have a Class 1 modem, then you can use either hardware or
software flow control, but beware of using hardware flow control
as the Class 1 specification only requires vendors to support
software flow control (and some of the Class 1 modems tried so far
do not support hardware flow control).
.LI
If you have a Class 2 or 2.0 modem, then you can use either hardware or
software flow control, but if you are going to communicate with the
modem faster than 9600 baud then you should probably use hardware
flow control.
.LI
If you have an Abaton 24/96 modem, then you must use software flow
control (the driver does not support hardware flow control).
.LE
.P
There are gotchas that you can expect to run into on most any system
when trying to interface to the system's serial port handling.  Consult
Chapter 7 of this document and the manual pages.
.P
With the executables installed and your modem happily connected to the
host with a proper cable, you can add modems with the \f2faxaddmodem\fP shell
script.  This is an interactive script that walks you through the
configuration and installation of a new or existing modem.  Note that
even if you have a previous version of this software installed you
should run the faxaddmodem script to update the configuration
information for your modems.  Below is a sample session.  Typed input
appears \f8emboldened\f1 with single carriage return characters indicated
by ``\f8<\s-1CR\s+1>\f1''; all other material is
printed by faxaddmodem.  Note that if your modem is configured to
communicate to the host at fixed baud rate, then you should use the
\-s option; for example ``\-s 38400'' to communicate at 38.4KB.
.sp
.nf
.ft 7
# \f8faxaddmodem\f7
Verifying your system is setup properly for fax service...

You do not appear to have a fax user in the password file.
The fax software needs this to work properly, add it [yes]? \f8<\s-1CR\s+1>\f7
Added user "fax" to /etc/passwd.

Adding fax user to "/etc/passwd.sgi".

There does not appear to be an entry for the fax service either in
the yellow pages database or in the /etc/services file;
should an entry be added to /etc/services [yes]? \f8<\s-1CR\s+1>\f7

There is no entry for the fax service in "/usr/etc/inetd.conf";
should one be added [yes]? \f8<\s-1CR\s+1>\f7
Poking inetd so that it re-reads the configuration file.

There does not appear to be an entry for the FaxMaster either in
the yellow pages database or in the /usr/lib/aliases file;
should an entry be added to /usr/lib/aliases [yes]? \f8<\s-1CR\s+1>\f7
Users to receive fax-related mail [sam]?  \f8<\s-1CR\s+1>\f7
Rebuilding /usr/lib/aliases database.
31 aliases, longest 75 bytes, 701 bytes total

Done verifying system setup.

Serial port that modem is connected to []? \f8ttyf2\f7

Ok, time to setup a configuration file for the modem.  The manual
page config(4F) may be useful during this process.  Also be aware
that at any time you can safely interrupt this procedure.

No existing configuration, let's do this from scratch.

Country code [1]?  \f8<\s-1CR\s+1>\f7
Area code [415]? \f8510\f7
Phone number of fax modem [+1.415.965.7824]? \f8+1 510 526-8781\f7
Long distance dialing prefix [1]? \f8<\s-1CR\s+1>\f7
International dialing prefix [011]? \f8<\s-1CR\s+1>\f7
Dial string rules file [etc/dialrules]? \f8etc/dialrules.sf-ba\f7
Tracing during normal server operation [1]? \f8<\s-1CR\s+1>\f7
Tracing during send and receive sessions [11]? \f8<\s-1CR\s+1>\f7
Protection mode for received facsimile [0600]? \f8644\f7
Protection mode for session logs [0600]? \f8644\f7
Protection mode for ttyf2 [0600]? \f8<\s-1CR\s+1>\f7
Rings to wait before answering [1]? \f8<\s-1CR\s+1>\f7
Modem speaker volume [off]? \f8<\s-1CR\s+1>\f7

The server configuration parameters are:

AreaCode                510
CountryCode             1
FAXNumber:              +1 510 526-8781
LongDistancePrefix:     1
InternationalPrefix:    011
DialStringRules:        etc/dialrules.sf-ba
ServerTracing:          1
SessionTracing:         11
RecvFileMode:           0644
LogFileMode:            0644
DeviceMode:             0600
RingsBeforeAnswer:      1
SpeakerVolume:          off

Are these ok [yes]? \f8n\f7
Country code [1]? \f8<\s-1CR\s+1>\f7
Area code [510]? \f8<\s-1CR\s+1>\f7
Phone number of fax modem [+1 510 526-8781]? \f8<\s-1CR\s+1>\f7
Long distance dialing prefix [1]?  \f8<\s-1CR\s+1>\f7
International dialing prefix [011]?  \f8<\s-1CR\s+1>\f7
Dial string rules file [etc/dialrules.sf-ba]? \f8<\s-1CR\s+1>\f7
Tracing during normal server operation [1]?  \f8<\s-1CR\s+1>\f7
Tracing during send and receive sessions [11]? \f83\f7
Protection mode for received facsimile [0644]? \f8<\s-1CR\s+1>\f7
Protection mode for session logs [0644]? \f8<\s-1CR\s+1>\f7
Protection mode for ttyf2 [0600]? \f8<\s-1CR\s+1>\f7
Rings to wait before answering [1]? \f8<\s-1CR\s+1>\f7
Modem speaker volume [off]? \f8<\s-1CR\s+1>\f7

The server configuration parameters are:

AreaCode                510
CountryCode             1
FAXNumber:              +1 510 526-8781
LongDistancePrefix:     1
InternationalPrefix:    011
DialStringRules:        etc/dialrules.sf-ba
ServerTracing:          1
SessionTracing:         3
RecvFileMode:           0644
LogFileMode:            0644
DeviceMode:             0600
RingsBeforeAnswer:      1
SpeakerVolume:          off

Are these ok [yes]? \f8<\s-1CR\s+1>\f7

Now we are going to probe the tty port to figure out the type
of modem that is attached.  This takes a few seconds, so be patient.
Note that if you do not have the modem cabled to the port, or the
modem is turned off, this may hang (just go and cable up the modem
or turn it on, or whatever).

This modem looks to have support for both Class 1 and 2;
how should it be configured [2]? \f8<\s-1CR\s+1>\f7

Hmm, this looks like a Class 2 modem.
Modem manufacturer is "AT&T Paradyne EDC".
Modem model is "3710-A2-203".

Using prototype configuration file config.att-dataport-2...

The modem configuration parameters are:

ModemDialCmd:           DT%s
ModemFlowControl:       rtscts
ModemFlowControlCmd:    &R0\eD1\eQ3
ModemRate:              38400
ModemRecvFillOrder:     MSB2LSB
ModemSendFillOrder:     LSB2MSB
ModemSetupAACmd:        +FAA=1
ModemSetupDCDCmd:       &C1
ModemSetupDTRCmd:       &D2
Class2DCCQueryCmd:      "!(0,1),(0-5),(0-4),(0-2),(0),(0),(0),(0-7)"

Are these ok [yes]? \f8<\s-1CR\s+1>\f7
Creating new configuration file "/usr/spool/fax/etc/config.ttyf2".
Creating "/usr/spool/fax/FIFO.ttyf2" in the spooling directory.
Done setting up the modem configuration.

Startup a facsimile server for this modem [yes] \f8<\s-1CR\s+1>\f7
/usr/etc/faxd -m /dev/ttyf2&
# 
.fi
.ft 1
.P
That's all there is to it (or at least all there \fIshould\fP be to it)!
You can also run faxaddmodem at a later time if you want to reconfigure
your modem.
.P
Beware that when the fax server process runs it normally keeps the
modem in a state suitable for sending and receiving facsimile.  This
may have implications for data communication programs such as tip, cu,
and uucp.  For example, if a Class 2 modem is being used, it may be
necessary to force the modem into Class 0 (for data communication) when
placing a call\(eme.g \s-1AT+FCLASS=0DT\s+1<phone number>.  Alternatively, you
can fiddle with the configuration parameters and keep the modem setup
for data use when the server is not actively using the modem.
.H 2 "Server Operation"
In normal operation configured facsimile servers should be started when
the system is booted and stay around so long as the system is running.
The normal installation process sets up the appropriate
configuration information for servers to be started up by init.
If you need to start a server by
hand, consult the \f2faxd\fP\|(1M) manual page.
.P
Incoming facsimile are placed in the \f2recvq\fP subdirectory of the spooling
area and probably will need to be cleaned up periodically.  Likewise
there is logging information in the \f2log\fP subdirectory and accounting
information in the \f2etc\fP subdirectory of the spooling area that may need
some attention.  The \f2faxcron\fP script is designed to handle the
periodic maintenance of the spooling area.  This script is designed to
be run from \f2cron\fP\|(1) every day; see \f2faxcron\fP\|(1M)
for detailed information on its operation.
If you want to do accounting check out the shell
scripts \f2xferstats\fP\|(1M) and \f2recvstats\fP\|(1M)
for a basic attack on how to process the \f2xferlog\fP
accounting file maintained for facsimile
transmissions and receptions (see also \f2xferlog\fP\|(1M)).
Otherwise the only matter to be concerned with is the support for data
connections.  If your modems are capable of differentiating data
connections from facsimile connections the fax server can invoke a
getty process and permit incoming data connections.  Alternatively, if
your modem does not support an adaptive answer facility, but it is a
Class 1 modem, the server may be able to do adaptive answering in
software.  In any event, beware that if you enable data connections you
should take the normal precautions you would take when there are dialup
ports on your machine.  Specifically, make sure that you have
passwords, appropriate file protections, and proper configuration of
uucp or similar.
.P
If you encounter problems with sending or receiving facsimile you can
enable copious tracing information by editing the configuration
files.  Consult the Troubleshooting chapter and the \f2config\fP\|(4F) and
\f2log\fP\|(4F) manual pages.
.H 2 "Adaptive-answering Strategies"
If your modem supports a good adaptive answering facility, then it
should be enabled with the
\f3ModemSetupAACmd\fP
and the server system will
automatically service fax or data calls as appropriate.
.P
If your modem does not support adaptive-answering (i.e. distinguishing
data from fax), then you have several options.  In all cases sending
facsimile is supported without problems.  If you have a Class 1 modem,
then you can request that the server employ a simple adaptive answering
strategy whereby incoming calls are first answered as if they are for a
fax machine and, if that fails, then answered as if they are for a data
modem.  This facility is enabled by specifying something like:
.sp .5
.nf
.ft 7
.ta \w'Class1RecvIdentTimer:  'u +\w'H+FCLASS=0;A    'u
AdaptiveAnswer:	yes		# enable adaptive answer
ModemAnswerCmd:	+FCLASS=1;A	# default is to answer as fax
ModemAnswerDataCmd:	H+FCLASS=0;A	# hangup and answer as data
Class1RecvIdentTimer: 10000		# timeout fax answer in 10 secs
.ft 1
.fi
.P
in the configuration file.   The above lines cause the fax server to do
the following in response to an incoming phone call:
.AL 1 +5
.LI
Issue "\s-1AT+FCLASS=1;A\s+1" to answer the phone call in Class 1;
i.e. as a fax machine (issuing \s-1CNG\s+1 tones).
.LI
Send \s-1TSI\s+1 and \s-1DIS\s+1 frames as required by the fax protocol.
.LI
Wait for \s-1DCS\s+1 from the caller (if it is a fax machine).
.LI
Timeout waiting for \s-1DCS\s+1 in 10 seconds (or whatever is specified
for \f3Class1RecvIdentTimer\fP).
.LI
Issue "\s-1ATH+FCLASS=0;A\s+1" to hangup and then re-answer the phone
in Class 0; i.e. as a data modem.
.LE
.P
This technique assumes many things about the capabilities of the modem
and the local telephony service and may not work for all Class 1 modems
or for all locales.
.P
A second facility supported by the fax server in lieu of adaptive
answering is a ``rotary of answering techniques''.  The general idea is
that a list of alternative ways to answer the phone is supplied and the
server will rotate through the list until it finds one that works.  For
example, one might specify something like:
.sp .5
.ta \w'AnswerRotary:    'u
.ft 7
AnswerRotary: "fax data"
.ft 1
.sp .5
which would instruct the server to answer incoming calls as if they
were from a fax machine until a call was received from something other
than a fax machine, in which case it would then answer subsequent calls
as a data modem until a non-data call was received (in which case it
would go back to fax).  The rotary list can have up to three items,
with items being selected from one of: fax, data, voice, and any
(answer a call of an unknown type).  The voice answering request is
reserved for future development.  Finally, in conjunction with the
rotary answer facility there is an \f3AnswerBias\fP parameter that can be
used to specify an index into the rotary list to use after
\fIsuccessfull\fP calls.  In the above example, this parameter can be used,
to force calls to always be answered first as data by specifying:
.sp .5
.ft 7
.nf
.ta \w'AnswerRotary:    'u
AnswerRotary:	"fax data"
AnswerBias:	1
.fi
.ft 1
.in -.5i
.H 2 "Non-adaptive-answering Strategies"
If you want to always process incoming calls as fax connections, then
you do not need to do anything; this is the normal setup.  If you want
to always process incoming calls as data connections, then you should
setup your modem configuration so that the \f3ModemAnswerCmd\fP parameter in
the configuration file causes the phone to be answered strictly as a
data modem.  For example, if you have a Class 1 or Class 2 modem, the
following should do this:
.sp .5
.ta \w'AnswerRotary:    'u
.ft 7
ModemAnswerCmd:	+FCLASS=0;A
.ft 1
.sp .5
(this sets the modem into class 0 and then answers the phone).  Another
possibility that you might opt for (especially if your modem is on a
phone line shared with a telephone) is to disable automatic answering
of the phone by setting the \f3RingsBeforeAnswer\fP parameter to zero:
.sp .5
.ta \w'AnswerRotary:    'u
.ft 7
RingsBeforeAnswer:	0
.ft 1
.sp .5
and then use the faxanswer program to explicitly request that the fax
server pick up the phone.  Note that by using the \-h option to \f2faxanswer\fP
you can control whether the fax server answers a phone call as fax,
or data (answering as voice is also supported for compatibility with
future work).
